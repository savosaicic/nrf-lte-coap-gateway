## CMakeLists.txt
```
cmake_minimum_required(VERSION 3.20.0)
find_package(Zephyr REQUIRED HINTS $ENV{ZEPHYR_BASE})

project(nrf_sensor_gateway)

target_include_directories(app PRIVATE include)

target_sources(app PRIVATE
  src/main.c
  src/modem.c
  src/sensor.c
  src/sensor_reader.c
  src/coap_libcoap.c
  src/sources.c
  src/temperature_sensor.c
  src/sensor_config.c
)
```

## Kconfig
```
menu "lte-sensor-gateway"

config SENSOR_READ_INTERVAL_MS
	int "Sensor read interval in milliseconds"
	default 60000 # 1 min

config COAP_SERVER_HOSTNAME
	string "CoAP server hostname"

config COAP_SERVER_PORT
	int "CoAP server port"
	default 5683

config COAP_TX_RESOURCE
	string "CoAP resource - this is the TX channel of the board"
	default "sensor/snapshot"

endmenu

menu "Zephyr Kernel"
source "Kconfig.zephyr"
endmenu
```

## prj.conf
```kconfig
CONFIG_LOG=y

# Modem
CONFIG_NRF_MODEM_LIB=y
CONFIG_LTE_LINK_CONTROL=y

# Temporary to generate random sensor values
CONFIG_ENTROPY_GENERATOR=y

# To print floating point 
CONFIG_CBPRINTF_FP_SUPPORT=y

# Networking
CONFIG_NETWORKING=y
CONFIG_NET_SOCKETS=y
CONFIG_NET_SOCKETS_OFFLOAD=y
CONFIG_POSIX_API=y

# Networking extras required by libcoap
CONFIG_NET_LOG=y
CONFIG_NET_NATIVE=y
CONFIG_NET_UDP=y
CONFIG_NET_TCP=y
CONFIG_NET_IPV4=y
CONFIG_NET_IPV6=y
CONFIG_XOPEN_STREAMS=y
CONFIG_DNS_RESOLVER=y

# libcoap3
CONFIG_LIBCOAP=y
CONFIG_MBEDTLS=n

# Memory
# libcoap allocates heap internally
CONFIG_HEAP_MEM_POOL_SIZE=131072
CONFIG_MAIN_STACK_SIZE=8192

CONFIG_EVENTS=y
```

## src/main.c
```c
#include <zephyr/logging/log.h>
#include <stdio.h>
#include <cJSON.h>

#include "modem.h"
#include "network_events.h"
#include "sensor.h"
#include "coap_backend.h"
#include "sensor_reader.h"

#define JSON_BUF_SIZE 1024

LOG_MODULE_REGISTER(nrf_sensor_gateway, LOG_LEVEL_DBG);

K_EVENT_DEFINE(network_events);

static const coap_backend_t *coap = &coap_backend_libcoap;

static int snapshot_to_json(const sensor_snapshot_t *snapshot, char *buf,
                            size_t buf_len)
{
  int ret = -ENOMEM;

  cJSON *root = cJSON_CreateObject();
  if (!root) {
    return -ENOMEM;
  }

  cJSON_AddNumberToObject(root, "ts", (double)snapshot->timestamp_ms);

  cJSON *readings = cJSON_AddArrayToObject(root, "readings");
  if (!readings) {
    goto cleanup;
  }

  for (size_t i = 0; i < snapshot->count; i++) {
    const sensor_reading_t *r = &snapshot->readings[i];

    cJSON *entry = cJSON_CreateObject();
    if (!entry) {
      goto cleanup;
    }

    cJSON_AddStringToObject(entry, "n", r->name);
    cJSON_AddNumberToObject(entry, "t", r->type);

    switch (r->type) {
    case SENSOR_TYPE_FLOAT:
      cJSON_AddNumberToObject(entry, "v", (double)r->value.f);
      break;
    case SENSOR_TYPE_INT:
      cJSON_AddNumberToObject(entry, "v", r->value.i);
      break;
    case SENSOR_TYPE_STRING:
      cJSON_AddStringToObject(entry, "v", r->value.s);
      break;
    case SENSOR_TYPE_BOOL:
      cJSON_AddBoolToObject(entry, "v", r->value.b);
      break;
    default:
      cJSON_Delete(entry);
      ret = -EINVAL;
      goto cleanup;
    }

    cJSON_AddItemToArray(readings, entry);
  }

  if (!cJSON_PrintPreallocated(root, buf, (int)buf_len, false)) {
    goto cleanup;
  }

  ret = (int)strlen(buf);

cleanup:
  cJSON_Delete(root);
  return ret;
}

int main(void)
{
  int               err;
  sensor_snapshot_t snapshot;
  char              json_buf[JSON_BUF_SIZE];

  /* Connect to lte-m (blocking function) */
  err = modem_configure();
  if (err) {
    LOG_ERR("Modem configuration failed: %d", err);
    return err;
  }

  /* Post an event to threads waiting for network to be configured */
  k_event_post(&network_events, NET_EVENT_LTE_CONNECTED);

  if (coap->init() != 0) {
    LOG_ERR("CoAP backend init failed — thread exiting");
    return -1;
  }

  while (1) {
    k_msgq_get(&sensor_msgq, &snapshot, K_FOREVER);
    int len = snapshot_to_json(&snapshot, json_buf, sizeof(json_buf));
    if (len < 0) {
      LOG_ERR("JSON encoding failed (%d) — dropping snapshot", len);
      continue;
    }

    LOG_DBG("Sending snapshot: %zu readings, %d bytes", snapshot.count, len);
    LOG_DBG("%s", json_buf);

    err = coap->send((const uint8_t *)json_buf, (size_t)len);
    if (err) {
      LOG_ERR("CoAP send failed (%d) — dropping snapshot", err);
      continue;
    }

    err = coap->recv();
    if (err == -ETIMEDOUT) {
      LOG_WRN("CoAP ACK timeout — snapshot may be lost");
    } else if (err) {
      LOG_ERR("CoAP recv error (%d)", err);
    }
  }

  return 0;
}
```

## include/coap_backend.h
```c
#ifndef COAP_BACKEND_H
#define COAP_BACKEND_H

#include <stddef.h>
#include <stdint.h>

/**
 * @brief CoAP backend interface
 *
 * @member init     Resolve server, open socket / create session.
 *                  Returns 0 on success, negative errno on failure.
 *
 * @member send     Build and send a CoAP POST.
 *                  Returns 0 on success, negative errno on failure.
 *
 * @member recv     Wait for and process one response.
 *                  Blocks until a response arrives or a timeout expires.
 *                  Returns 0 on success, negative errno on hard error.
 *
 * @member cleanup  Release all resources (socket, session, context, …).
 */
typedef struct coap_backend_s {
  int  (*init)(void);
  int  (*send)(const uint8_t *, size_t);
  int  (*recv)(void);
  void (*cleanup)(void);
} coap_backend_t;

/* libcoap backend            →  coap_libcoap.c */
extern const coap_backend_t coap_backend_libcoap;

#endif /* COAP_BACKEND_H */
```

## include/data_source.h
```c
#ifndef DATA_SOURCE_H
#define DATA_SOURCE_H

typedef struct {
  const char *name; /* eg: "lsm303agr" */

  /* Allocate channels and configure hardware
   * return - on success, negative errno on failure
   */
  int (*init)(void);

  /* Called by sensor_reader thread
   * Driver reads hardware and calls sensor_channel_update_*() internally
   * return 0 on success, negative errno on failure
   */
  int (*read)(void);

} data_source_t;

#endif /* !DATA_SOURCE_H */
```

## include/network_events.h
```c
#ifndef NETWORK_EVENTS_H
#define NETWORK_EVENTS_H

#include <zephyr/kernel.h>

#define NET_EVENT_LTE_CONNECTED BIT(0)

extern struct k_event network_events;

#endif /* NETWORK_EVENTS_H */
```

## include/sensor.h
```c
#ifndef SENSOR_H
#define SENSOR_H

#include <stdbool.h>
#include <stddef.h>
#include <stdint.h>

#define SENSOR_MAX_CHANNELS   16
#define SENSOR_NAME_MAX_LEN   16
#define SENSOR_STRING_MAX_LEN 64

typedef enum {
  SENSOR_TYPE_FLOAT = 0,
  SENSOR_TYPE_INT,
  SENSOR_TYPE_STRING,
  SENSOR_TYPE_BOOL,
} sensor_type_t;

typedef union {
  float f;
  int   i;
  char  s[SENSOR_STRING_MAX_LEN];
  bool  b;
} sensor_value_t;

typedef struct {
  char           name[SENSOR_NAME_MAX_LEN];
  sensor_type_t  type;
  sensor_value_t value;
  bool           has_value;
} sensor_channel_t;

/**
 * @brief One reading captured at snapshot time.
 *
 * Intentionally a plain-data copy with no registry state — safe to
 * hand off to another thread or serialise without holding any lock.
 */
typedef struct {
  char           name[SENSOR_NAME_MAX_LEN];
  sensor_type_t  type;
  sensor_value_t value;
} sensor_reading_t;

typedef struct {
  sensor_reading_t readings[SENSOR_MAX_CHANNELS];
  size_t           count;
  int64_t          timestamp_ms;
} sensor_snapshot_t;

sensor_channel_t *sensor_channel_register(const char *name, sensor_type_t type);

int sensor_channel_update_float(sensor_channel_t *ch, float value);
int sensor_channel_update_int(sensor_channel_t *ch, int value);
int sensor_channel_update_string(sensor_channel_t *ch, const char *value);
int sensor_channel_update_bool(sensor_channel_t *ch, bool value);

void sensor_snapshot_take(sensor_snapshot_t *snapshot);

#endif /* SENSOR_H */
```

## include/sensor_config.h
```c
#ifndef SENSOR_CONFIG_H
#define SENSOR_CONFIG_H

#include <stddef.h>

#include "data_source.h"

extern data_source_t *g_data_sources[];
extern const size_t   g_data_source_count;

#endif /* !SENSOR_CONFIG_H */
```

## include/sensor_reader.h
```c
#ifndef SENSOR_READER_H
#define SENSOR_READER_H

#include <zephyr/kernel.h>

/** 
 * Message queue through which the sensor reader thread delivers
 * sensor_snapshot_t objects.
 */
extern struct k_msgq sensor_msgq;

#endif /* SENSOR_READER_H */
```

## include/sources.h
```c
#ifndef SOURCES_H
#define SOURCES_H

int sources_init_all(void);
int sources_read_all(void);

#endif /* !SOURCES_H */
```

## src/coap_libcoap.c
```c
#include <zephyr/kernel.h>
#include <zephyr/logging/log.h>
#include <coap3/coap.h>

#include "coap_backend.h"

LOG_MODULE_REGISTER(coap_libcoap, LOG_LEVEL_DBG);

#define COAP_SERVER_URI \
	"coap://" CONFIG_COAP_SERVER_HOSTNAME \
	":" STRINGIFY(CONFIG_COAP_SERVER_PORT) "/" CONFIG_COAP_TX_RESOURCE

#define RECV_TIMEOUT_MS 5000

static coap_context_t *g_ctx     = NULL;
static coap_session_t *g_session = NULL;
static coap_uri_t      g_uri;
static coap_address_t  g_dst;

/* Set to 1 by the response handler; reset to 0 before each send */
static volatile int response_received;

static int resolve_address(coap_str_const_t *host, uint16_t port,
                           coap_address_t *dst, int scheme_hint_bits)
{
	coap_addr_info_t *addr_info;

	addr_info = coap_resolve_address_info(host, port, port, port, port,
					      AF_UNSPEC, scheme_hint_bits,
					      COAP_RESOLVE_TYPE_REMOTE);
	if (!addr_info) {
		return 0;
	}

	*dst = addr_info->addr;
	coap_free_address_info(addr_info);
	return 1;
}

static coap_response_t response_handler(coap_session_t   *session,
                                        const coap_pdu_t *sent,
                                        const coap_pdu_t *received,
                                        const coap_mid_t  id)
{
	const uint8_t *data;
	size_t len, offset, total;

	ARG_UNUSED(session);
	ARG_UNUSED(sent);
	ARG_UNUSED(id);

	if (coap_get_data_large(received, &len, &data, &offset, &total)) {
    LOG_INF("Response (%zu/%zu bytes): %*.*s",
		       len + offset, total,
		       (int)len, (int)len, (const char *)data);
		if (len + offset == total) {
			response_received = 1;
		}
	}

	return COAP_RESPONSE_OK;
}

static int libcoap_init()
{
	coap_startup();

  g_ctx = coap_new_context(NULL);
  if (!g_ctx) {
    LOG_ERR("Failed to create CoAP context");
    return -ENOMEM;
  }
  coap_context_set_block_mode(g_ctx, COAP_BLOCK_USE_LIBCOAP);

  /* Parse the server URI */
  if (coap_split_uri((const uint8_t *)COAP_SERVER_URI, strlen(COAP_SERVER_URI),
                     &g_uri) != 0) {
    LOG_ERR("Failed to parse URI: %s", COAP_SERVER_URI);
    return -EINVAL;
  }

  /* Resolve hostname to a coap_address_t */
  if (!resolve_address(&g_uri.host, g_uri.port, &g_dst, 1 << g_uri.scheme)) {
    LOG_ERR("Failed to resolve address for host");
    return -ENOENT;
  }

  /* Open a UDP session toward the server */
  g_session = coap_new_client_session3(g_ctx, NULL, &g_dst, COAP_PROTO_UDP,
                                       NULL, NULL, NULL);
  if (!g_session) {
    LOG_ERR("Failed to create CoAP session");
    return -EIO;
  }

  coap_register_response_handler(g_ctx, response_handler);

  LOG_INF("libcoap3 backend ready");
  return 0;
}

static int libcoap_send(const uint8_t *payload, size_t len)
{
  coap_pdu_t     *pdu     = NULL;
  coap_optlist_t *optlist = NULL;
  int             ret     = -EIO;

  pdu = coap_pdu_init(COAP_MESSAGE_CON, COAP_REQUEST_CODE_POST,
                      coap_new_message_id(g_session),
                      coap_session_max_pdu_size(g_session));
  if (!pdu) {
    LOG_ERR("Failed to create PDU");
    goto out;
  }

  if (!coap_uri_into_optlist(&g_uri, &g_dst, &optlist, 1)) {
    LOG_ERR("Failed to build URI options");
    goto out;
  }

  if (coap_add_optlist_pdu(pdu, &optlist) != 1) {
    LOG_ERR("Failed to add options to PDU");
    goto out;
  }

  uint8_t fmt_buf[2];
  size_t  fmt_len = coap_encode_var_safe(fmt_buf, sizeof(fmt_buf),
                                         COAP_MEDIATYPE_APPLICATION_JSON);
  coap_add_option(pdu, COAP_OPTION_CONTENT_FORMAT, fmt_len, fmt_buf);

  coap_add_data(pdu, len, payload);

  if (coap_send(g_session, pdu) == COAP_INVALID_MID) {
    LOG_ERR("coap_send() failed");
    coap_delete_pdu(pdu);
    pdu = NULL;
    goto out;
  }

  pdu = NULL;
  ret = 0;
  LOG_INF("CoAP POST sent (%zu bytes)", len);

out:
  coap_delete_optlist(optlist);
  if (pdu) {
    coap_delete_pdu(pdu);
  }
  return ret;
}

static int libcoap_recv(void)
{
  int64_t deadline;

  response_received = 0;
  deadline = k_uptime_get() + RECV_TIMEOUT_MS;

  while (!response_received && k_uptime_get() < deadline) {
    coap_io_process(g_ctx, 500);
  }

  if (!response_received) {
    LOG_WRN("No response received within %d ms", RECV_TIMEOUT_MS);
  }

  return 0;
}

static void libcoap_cleanup(void)
{
  /* Session is owned by the context; freeing the context is enough */
  coap_free_context(g_ctx);
  g_ctx     = NULL;
  g_session = NULL;
  coap_cleanup();
}

const coap_backend_t coap_backend_libcoap = {
  .init = libcoap_init,
  .send = libcoap_send,
  .recv = libcoap_recv,
  .cleanup = libcoap_cleanup,
};
```

## src/modem.c
```c
#include <modem/lte_lc.h>
#include <modem/nrf_modem_lib.h>
#include <zephyr/logging/log.h>

LOG_MODULE_REGISTER(modem, LOG_LEVEL_DBG);

static K_SEM_DEFINE(lte_connected_sem, 0, 1);

static void lte_handler(const struct lte_lc_evt *const evt)
{
  switch (evt->type) {
  case LTE_LC_EVT_NW_REG_STATUS:
    if (evt->nw_reg_status != LTE_LC_NW_REG_REGISTERED_HOME &&
        evt->nw_reg_status != LTE_LC_NW_REG_REGISTERED_ROAMING) {
      break;
    }
    LOG_INF("LTE registered: %s",
            evt->nw_reg_status == LTE_LC_NW_REG_REGISTERED_HOME ? "home network"
                                                                : "roaming");
    k_sem_give(&lte_connected_sem);
    break;

  case LTE_LC_EVT_RRC_UPDATE:
    LOG_INF("RRC mode: %s",
            evt->rrc_mode == LTE_LC_RRC_MODE_CONNECTED ? "connected" : "idle");
    break;

  default:
    break;
  }
}

int modem_configure(void)
{
	int err;

	LOG_INF("Initializing modem library");
	err = nrf_modem_lib_init();
	if (err) {
		LOG_ERR("Failed to initialize modem library: %d", err);
		return err;
	}

	LOG_INF("Connecting to LTE network");
	err = lte_lc_connect_async(lte_handler);
	if (err) {
		LOG_ERR("lte_lc_connect_async failed: %d", err);
		return err;
	}

	k_sem_take(&lte_connected_sem, K_FOREVER);
	LOG_INF("Connected to LTE network");
	return 0;
}
```

## src/sensor.c
```c
#include <zephyr/kernel.h>
#include <zephyr/logging/log.h>
#include <stddef.h>
#include <string.h>

#include "sensor.h"

LOG_MODULE_REGISTER(sensor, LOG_LEVEL_DBG);

static sensor_channel_t g_channels[SENSOR_MAX_CHANNELS];
static size_t           g_channel_count = 0;

K_MUTEX_DEFINE(g_mutex);

sensor_channel_t *sensor_channel_register(const char *name, sensor_type_t type)
{
  sensor_channel_t *ch;

  if (!name || strlen(name) == 0) {
    LOG_ERR("Channel name must not be empty");
    return NULL;
  }

  k_mutex_lock(&g_mutex, K_FOREVER);

  if (g_channel_count >= SENSOR_MAX_CHANNELS) {
    LOG_ERR("Channel registry is full (max %zu)", SENSOR_MAX_CHANNELS);
    k_mutex_unlock(&g_mutex);
    return NULL;
  }

  for (size_t i = 0; i < g_channel_count; i++) {
    if (strcmp(g_channels[i].name, name) == 0) {
      LOG_ERR("Channel `%s` already registered", name);
      k_mutex_unlock(&g_mutex);
      return NULL;
    }
  }

  ch = &g_channels[g_channel_count++];
  memset(ch, 0, sizeof(*ch));
  strncpy(ch->name, name, SENSOR_NAME_MAX_LEN - 1);
  ch->type      = type;
  ch->has_value = false;

  LOG_DBG("Registered channel '%s' (type=%d, slot=%zu)", ch->name, type,
          g_channel_count - 1);
  k_mutex_unlock(&g_mutex);
  return ch;
}

int sensor_channel_update_float(sensor_channel_t *ch, float value)
{
  if (!ch || ch->type != SENSOR_TYPE_FLOAT) {
    return -EINVAL;
  }
  k_mutex_lock(&g_mutex, K_FOREVER);
  ch->value.f   = value;
  ch->has_value = true;
  k_mutex_unlock(&g_mutex);
  return 0;
}

int sensor_channel_update_int(sensor_channel_t *ch, int value)
{
  if (!ch || ch->type != SENSOR_TYPE_INT) {
    return -EINVAL;
  }
  k_mutex_lock(&g_mutex, K_FOREVER);
  ch->value.i   = value;
  ch->has_value = true;
  k_mutex_unlock(&g_mutex);
  return 0;
}

int sensor_channel_update_string(sensor_channel_t *ch, const char *value)
{
  if (!ch || ch->type != SENSOR_TYPE_STRING) {
    return -EINVAL;
  }
  k_mutex_lock(&g_mutex, K_FOREVER);
  strncpy(ch->value.s, value, SENSOR_STRING_MAX_LEN - 1);
  ch->value.s[SENSOR_STRING_MAX_LEN - 1] = '\0';
  ch->has_value = true;

  k_mutex_unlock(&g_mutex);
  return 0;
}

int sensor_channel_update_bool(sensor_channel_t *ch, bool value)
{
  if (!ch || ch->type != SENSOR_TYPE_BOOL) {
    return -EINVAL;
  }
  k_mutex_lock(&g_mutex, K_FOREVER);
  ch->value.b   = value;
  ch->has_value = true;
  k_mutex_unlock(&g_mutex);
  return 0;
}

void sensor_snapshot_take(sensor_snapshot_t *snapshot)
{
  if (!snapshot) {
    LOG_ERR("sensor_snapshot_take got a null pointer");
    return;
  }

	memset(snapshot, 0, sizeof(*snapshot));
	snapshot->timestamp_ms = k_uptime_get();

	k_mutex_lock(&g_mutex, K_FOREVER);

	for (size_t i = 0; i < g_channel_count; i++) {
		const sensor_channel_t *ch = &g_channels[i];

		if (!ch->has_value) {
			continue;
		}

		sensor_reading_t *r = &snapshot->readings[snapshot->count++];
		strncpy(r->name, ch->name, SENSOR_NAME_MAX_LEN - 1);
		r->type = ch->type;

		switch (ch->type) {
		case SENSOR_TYPE_FLOAT:
			r->value.f = ch->value.f;
			break;
		case SENSOR_TYPE_INT:
			r->value.i = ch->value.i;
			break;
		case SENSOR_TYPE_STRING:
			strncpy(r->value.s, ch->value.s, SENSOR_STRING_MAX_LEN - 1);
			r->value.s[SENSOR_STRING_MAX_LEN - 1] = '\0';
			break;
		case SENSOR_TYPE_BOOL:
			r->value.b = ch->value.b;
			break;
		}
	}

	k_mutex_unlock(&g_mutex);
}
```

## src/sensor_config.c
```c
#include <zephyr/sys/util.h>
#include <stddef.h>

#include "data_source.h"

extern data_source_t temperature_sensor_source;

data_source_t *g_data_sources[] = {
  &temperature_sensor_source,
};
const size_t g_data_source_count = ARRAY_SIZE(g_data_sources);
```

## src/sensor_reader.c
```c
#include <zephyr/kernel.h>
#include <zephyr/logging/log.h>
#include <zephyr/random/random.h>
#include <stddef.h>

#include "sensor.h"
#include "network_events.h"
#include "sources.h"

LOG_MODULE_REGISTER(sensor_reader, LOG_LEVEL_DBG);

#define STACKSIZE       2048
#define THREAD_PRIORITY 7

K_MSGQ_DEFINE(sensor_msgq, sizeof(sensor_snapshot_t), 4, 1);

static void sensor_reader_thread(void)
{
  int err;

  err = sources_init_all();
  if (err) {
    LOG_ERR("sources_init_all() failed: %d", err);
    return;
  }

  LOG_INF("Waiting for LTE connection...");
  k_event_wait(&network_events, NET_EVENT_LTE_CONNECTED, false, K_FOREVER);
  LOG_INF("LTE connected — starting sensor reads");

  while (1) {
    sources_read_all();

		sensor_snapshot_t snapshot;
		sensor_snapshot_take(&snapshot);

    if (k_msgq_put(&sensor_msgq, &snapshot, K_NO_WAIT) != 0) {
      LOG_WRN("Queue full — dropping snapshot (%zu readings)", snapshot.count);
		} else {
			LOG_DBG("Enqueued snapshot: %zu readings", snapshot.count);
		}

    k_msleep(CONFIG_SENSOR_READ_INTERVAL_MS);
  }
}

K_THREAD_DEFINE(sensor_reader_id, STACKSIZE, sensor_reader_thread, NULL, NULL,
                NULL, THREAD_PRIORITY, 0, 0);
```
