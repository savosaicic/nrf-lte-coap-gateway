## west.yml
```yaml
manifest:
  remotes:
    - name: ncs
      url-base: https://github.com/nrfconnect

  projects:
    - name: nrf
      repo-path: sdk-nrf
      remote: ncs
      revision: v3.2.2
      import: true

    - name: libcoap
      url: https://github.com/obgm/libcoap
      revision: develop
      path: modules/libcoap

  self:
    path: nrf-lte-coap-gateway
```
